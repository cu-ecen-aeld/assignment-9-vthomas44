## base_external/package/aesd-assignments/Config.in
```kconfig
config BR2_PACKAGE_AESD_ASSIGNMENTS
	bool "aesd-assignments"
	help
	  Includes the writer executable, finder.sh and tester.sh in the kernel image.
	  Used to understand buildroot external trees and package builds.

config BR2_PACKAGE_AESDCHAR
    bool "aesdchar driver"
    help
      Build and install aesdchar kernel module from GitHub (assignment 9)
```

## base_external/package/aesdchar/Config.in
```kconfig
config BR2_PACKAGE_AESDCHAR
    bool "aesdchar driver"
    help
      Build and install aesdchar kernel module from GitHub (assignment 8)
```
